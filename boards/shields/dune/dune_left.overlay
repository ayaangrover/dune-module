#include "dune.dtsi"

&kscan0 {
    row-gpios = 
        <&pro_micro 6 (GPIO_ACTIVE_HIGH | GPIO_PULL_DOWN)>,
        <&pro_micro 8 (GPIO_ACTIVE_HIGH | GPIO_PULL_DOWN)>,
        <&pro_micro 17 (GPIO_ACTIVE_HIGH | GPIO_PULL_DOWN)>,
        <&pro_micro 22 (GPIO_ACTIVE_HIGH | GPIO_PULL_DOWN)>;

    col-gpios = 
        <&pro_micro 20 GPIO_ACTIVE_HIGH>,
        <&pro_micro 24 GPIO_ACTIVE_HIGH>,
        <&pro_micro 100 GPIO_ACTIVE_HIGH>,
        <&pro_micro 101 GPIO_ACTIVE_HIGH>,
        <&pro_micro 104 GPIO_ACTIVE_HIGH>,
        <&pro_micro 106 GPIO_ACTIVE_HIGH>;
};
