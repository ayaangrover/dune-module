## boards/shields/dune/Kconfig.defconfig
```kconfig
if SHIELD_DUNE_LEFT

config ZMK_KEYBOARD_NAME
    default "Dune"

config ZMK_SPLIT_ROLE_CENTRAL
    default y

endif

if SHIELD_DUNE_LEFT || SHIELD_DUNE_RIGHT

config ZMK_SPLIT
    default y

endif
```

## boards/shields/dune/Kconfig.shield
```kconfig
config SHIELD_DUNE_LEFT
    def_bool $(shields_list_contains,dune_left)

config SHIELD_DUNE_RIGHT
    def_bool $(shields_list_contains,dune_right)
```
